## components/battery_monitor/Kconfig.projbuild
```kconfig
menu "Battery monitor"
    config BATTERY_MON_LOW_BATTERY_THRESHOLD_MV
        int
        default 3500
        prompt "Battery low state threshold (mV)"
        help
            Under this threshold, the battery monitor considers the battery voltage as LOW.
    config BATTERY_MON_CRITICAL_BATTERY_THRESHOLD_MV
        int
        default 3200
        prompt "Battery critical sate threshold (mV)"
        help
            Under this voltage threshold, the battery montiro considers the battery voltage as CRITICAL.
    config BATTERY_MONITOR_SAMPLE_PERIOD_MS
        int
        default 1000
        prompt "Battery monitor ADC sample period (milliseconds)"
        help
            The number of milliseconds between two battery monitor samples.
    config BATTERY_MON_ADC_GPIO_NUM
        int
        default 35
        prompt "GPIO number of the PIN connected to the battery voltage analog output"

endmenu
```

## components/camera_client/Kconfig.projbuild
```kconfig
menu "Camera HTTP client"
    config WIFI_AP_SSID
        string
        default ""
        prompt "Wifi access point SSID"

    config WIFI_AP_PASSWORD
        string
        default ""
        prompt "Wifi access point password (WPA or WPA2)"

    config WIFI_AP_MAX_CONNECTION_ATTEMPTS
        int
        default 5
        prompt "Wifi connection attempt limit"

    config CAMERA_SERVER_URL
        string
        default ""
        prompt "URL string of the server hosting the camera service"
endmenu
```

## components/gps/Kconfig.projbuild
```kconfig
menu "GPS (NMEA) parser"
    config GPS_PARSER_BUFFER_SIZE
        int
        default 256
        prompt "UART Rx buffer size (bytes)"
        help
            Set the size of the Rx ring buffer that receives the data frames.

    config GPS_PARSER_EVENT_QUEUE_LENGTH
        int
        default 5
        prompt "GPS data event queue length"
        help
            Set the maximum number of GPS data events held by the data queue. 

    config GPS_PARSER_TASK_STACK_DEPTH
        int
        default 2048 
        prompt "Parser task stack depth (words)"
        help
            Set the stack depth of the FreeRTOS GPS parser task.

    config GPS_PARSER_TASK_PRIORITY
        int 
        default 5
        prompt "Parser task priority"
        help
            Set the priority of the GPS parser task.
endmenu
```

## components/hmi/Kconfig.projbuild
```kconfig
menu "HMI"
    config HMI_FEEDBACK_EVENT_QUEUE_LENGTH
        int
        default 10
        prompt "Feedback event queue length"
        help
            Maximum number of events that the feedback event queue can hold at a time.

    config HMI_BUZZER_PIN_NUMBER
        int
        default 23
        prompt "Buzzer digital output GPIO number"
        help
            GPIO number of the pin connected to the buzzer output.
            
    config HMI_POWER_BUTTON_PIN_NUMBER
        int
        default 34
        prompt "Button input GPIO number"
        help
            GPIO number of the pin connected to the power on/off button input.
endmenu
```

## components/imu/Kconfig.projbuild
```kconfig
menu "IMU"
    config IMU_SDA_GPIO_NUM
        int
        default 21
        prompt "GPIO connected to the IMU's I2C bus SDA"
        help
            GPIO number of the pin connected to the SDA pin of the I2C bus where the IMU is connected.

    config IMU_SCL_GPIO_NUM
        int
        default 22
        prompt "GPIO connected to the IMU's I2C bus SCL"
        help
            GPIO number of the pin connected to the SCL pin of the I2C bus where the IMU is connected.
        
    config IMU_I2C_BUS_FREQ_HZ
        int
        default 100000
        prompt "IMU I2C bus clock frequency (Hz)"
        help
            Frequency in Hz used in I2C communication with the IMU.

    config IMU_INTERRUPT_GPIO_NUM
        int
        default 13
        prompt "IMU interrupt pin GPIO number"
        help
            GPIO number connected to the interrupt PIN of the IMU.
endmenu
```

## components/power_save/Kconfig.projbuild
```kconfig
menu "Power save"
    config WAIT_BEFORE_DEEP_SLEEP_ENTER_MS
        int
        default 1000
        prompt "Milliseconds to wait before entering deep sleep after conditions are met"
        help
            If deep sleep conditions are met, the power save module waits at least this number of milliseconds before entering sleep.        
endmenu
```

## components/tf_mini_parser/Kconfig.projbuild
```kconfig
menu "TF Mini parser"
    config TF_MINI_PARSER_BUFFER_SIZE
        int
        default 256
        prompt "UART Rx buffer size (bytes)"
        help
            Set the size of the Rx ring buffer that receives the data frames.

    config TF_MINI_PARSER_TASK_STACK_DEPTH
        int
        default 2048 
        prompt "Parser task stack depth (words)"
        help
            Set the stack depth of the FreeRTOS parser task.

    config TF_MINI_PARSER_TASK_PRIORITY
        int 
        default 5
        prompt "Parser task priority"
        help
            Set the priority of the parser task.
endmenu
```

## main/Kconfig.projbuild
```kconfig
menu "Main"
    config FEEDBACK_EVENT_QUEUE_LENGTH
        int
        default 10
        prompt "User feedback event queue length (items)"
        help
            Set the maximum number of feedback events that the queue can hold.
        
    config NAV_SEL_INPUT_PIN
        int
        default 24
        prompt "GPIO for navigation route selection"
        help
            GPIO number connected to button used to select the navigation route.
            
    config NAV_SAFE_AREA_RADIUS_CM
        int
        default 140
        prompt "Navigation safe area radius (cm)"
        help
            Distance from waypoint that is considered inside boundaries (centimeters).

    config NAV_COORDINATE_PRECISION
        int
        default 10
        prompt "Coordinate precision"
        help
            If the latitude and longitude of two coordinates both differ by less than the coordinate precision, consider them equal.

    config NAV_WAYPOINT_VISIT_DISTANCE_CM
        int
        default 100
        prompt "Navigation waypoint visit distance (cm)"
        help
            Distance from waypoint that navigation considers as a visit (centimeters).

    config NAV_NOTIFY_BEFORE_WAYPOINT_DISTANCE_CM
        int
        default 300
        prompt "Distance from waypoint where navigation notifies the user (cm)"
        help
            How far from the waypoint should navigation notify the user of the next action (centimeters).

    config NAV_FEEDBACK_POST_TIMEOUT_MS
        int
        default 1000
        prompt "Maximum wait for posting a navigation feedback event (ms)"
        help
            How much time should the navigation task wait for the feedback event queue to have free space.        
endmenu
```
